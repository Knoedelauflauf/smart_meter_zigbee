## child_image/mcuboot/boards/xiao_ble.conf
```kconfig
CONFIG_MAIN_STACK_SIZE=10240
CONFIG_MBEDTLS_CFG_FILE="mcuboot-mbedtls-cfg.h"
CONFIG_BOOT_SWAP_SAVE_ENCTLV=n
CONFIG_BOOT_ENCRYPT_RSA=n
CONFIG_BOOT_ENCRYPT_EC256=n
CONFIG_BOOT_ENCRYPT_X25519=n
CONFIG_BOOT_UPGRADE_ONLY=n
CONFIG_BOOT_BOOTSTRAP=n
CONFIG_FLASH=y
CONFIG_FPROTECT=y
CONFIG_USB_DEVICE_STACK=n
CONFIG_BUILD_OUTPUT_UF2=n
CONFIG_USB_DEVICE_INITIALIZE_AT_BOOT=n
CONFIG_LOG=n
CONFIG_CBPRINTF_NANO=y
CONFIG_NRF_RTC_TIMER_USER_CHAN_COUNT=0
```
